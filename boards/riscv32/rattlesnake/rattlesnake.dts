/dts-v1/;

#include <riscv32-rattlesnake.dtsi>

/ {
	model = "rattlesnake_riscv32";
	compatible = "rattlesnake,riscv32";

	aliases {
		uart_0 = &uart0;
	};

	chosen {
		zephyr,sram = &sram0;
		zephyr,flash = &flash0;
		zephyr,console = &uart0;
	};
};

&uart0 {
	status = "ok";
	current-speed = <115200>;
};
