## arch/riscv32/soc/riscv-privilege/pulserain-reindeer/Kconfig.defconfig.series
```kconfig
if SOC_SERIES_PULSERAIN_REINDEER

config SOC_SERIES
	string
	default "pulserain-reindeer"

config SYS_CLOCK_HW_CYCLES_PER_SEC
	int
	default 1000000

config RISCV_SOC_INTERRUPT_INIT
	bool
	default y

config INCLUDE_RESET_VECTOR
	bool
	default y

config NUM_IRQS
	int
	default 32

config RISCV_RAM_SIZE_KB
	int
	default 32

endif # SOC_SERIES_PULSERAIN_REINDEER
```

## arch/riscv32/soc/riscv-privilege/pulserain-reindeer/Kconfig.series
```kconfig
# Kconfig - PulseRain Reindeer SOC implementation
#
# Copyright (c) 2018 PulseRain Technology, LLC
#
# SPDX-License-Identifier: Apache-2.0
#

config SOC_SERIES_PULSERAIN_REINDEER
	bool "PulseRain Reindeer RISCV32 SOC implementation"
	depends on RISCV32
	select SOC_FAMILY_RISCV_PRIVILEGE
	help
	  Enable support for PulseRain Reindeer RISCV32 SOC implementation
```

## arch/riscv32/soc/riscv-privilege/pulserain-reindeer/Kconfig.soc
```kconfig
# Kconfig - PULSERAIN_REINDEER SOC configuration options
#
# Copyright (c) 2018 PulseRain Technology, LLC
#
# SPDX-License-Identifier: Apache-2.0
#

choice
prompt "PulseRain Reindeer SOC implementation"
depends on SOC_SERIES_PULSERAIN_REINDEER

config SOC_PULSERAIN_REINDEER
	bool "PulseRain Reindeer SOC implementation"
	select ATOMIC_OPERATIONS_C

endchoice
```

## boards/riscv32/rattlesnake/Kconfig.board
```kconfig
config BOARD_RATTLESNAKE
	bool "PulseRain Rattlesnake RISCV32 target"
	depends on SOC_PULSERAIN_RATTLESNAKE
	select RATTLESNAKE_TARGET
	select HAS_DTS
```

## boards/riscv32/rattlesnake/Kconfig.defconfig
```kconfig
if BOARD_RATTLESNAKE

config BUILD_OUTPUT_BIN
        default n

config BOARD
	default "rattlesnake"

endif
```

## boards/riscv32/rattlesnake/rattlesnake_defconfig
```kconfig
CONFIG_RISCV32=y
CONFIG_SOC_SERIES_PULSERAIN_RATTLESNAKE=y
CONFIG_SOC_PULSERAIN_RATTLESNAKE=y
CONFIG_BOARD_RATTLESNAKE=y
CONFIG_CONSOLE=y
CONFIG_PRINTK=y
CONFIG_SERIAL=y
CONFIG_UART_PULSERAIN_RATTLESNAKE=y
CONFIG_UART_CONSOLE=y
CONFIG_UART_CONSOLE_ON_DEV_NAME="uart0"
CONFIG_RISCV_MACHINE_TIMER=y
CONFIG_BOOT_BANNER=y
```

## boards/riscv32/reindeer/Kconfig.board
```kconfig
config BOARD_REINDEER
	bool "PulseRain Reindeer RISCV32 target"
	depends on SOC_PULSERAIN_REINDEER
	select REINDEER_TARGET
	select HAS_DTS
```

## boards/riscv32/reindeer/Kconfig.defconfig
```kconfig
if BOARD_REINDEER

config BUILD_OUTPUT_BIN
        default n

config BOARD
	default "reindeer"

endif
```

## boards/riscv32/reindeer/reindeer_defconfig
```kconfig
CONFIG_RISCV32=y
CONFIG_SOC_SERIES_PULSERAIN_REINDEER=y
CONFIG_SOC_PULSERAIN_REINDEER=y
CONFIG_BOARD_REINDEER=y
CONFIG_CONSOLE=y
CONFIG_PRINTK=y
CONFIG_SERIAL=y
CONFIG_UART_PULSERAIN_REINDEER=y
CONFIG_UART_CONSOLE=y
CONFIG_UART_CONSOLE_ON_DEV_NAME="uart0"
CONFIG_RISCV_MACHINE_TIMER=y
CONFIG_BOOT_BANNER=y
```

## drivers/serial/Kconfig.pulserain_rattlesnake
```kconfig
# Kconfig.pulserain_rattlesnake - pulserain_rattlesnake UART configuration option
#
# Copyright (c) 2016 Jean-Paul Etienne <fractalclone@gmail.com>
#
# SPDX-License-Identifier: Apache-2.0
#

menuconfig UART_PULSERAIN_RATTLESNAKE
	bool "PulseRain Rattlesnake UART driver"
	depends on SOC_PULSERAIN_RATTLESNAKE
	select SERIAL_HAS_DRIVER
	help
	  Enable the PulseRain Rattlesnake UART driver.
```

## drivers/serial/Kconfig.pulserain_reindeer
```kconfig
# Kconfig.riscv_qemu - riscv-qemu UART configuration option
#
# Copyright (c) 2016 Jean-Paul Etienne <fractalclone@gmail.com>
#
# SPDX-License-Identifier: Apache-2.0
#

menuconfig UART_PULSERAIN_REINDEER
	bool "PulseRain Reindeer UART driver"
	depends on SOC_PULSERAIN_REINDEER
	select SERIAL_HAS_DRIVER
	help
	  Enable the PulseRain Reindeer UART driver.
```

## dts/bindings/serial/riscv,rattlesnake-uart.yaml
```yaml
---
title: RISCV RATTLESNAKE UART
id: riscv,rattlesnake-uart
version: 0.1

description: >
    This binding gives a base representation of the RISCV RATTLESNAKE UART

inherits:
    !include uart.yaml

properties:
    compatible:
      type: string
      category: required
      description: compatible strings
      constraint: "riscv,rattlesnake-uart"

    reg:
      type: array
      description: mmio register space
      generation: define
      category: required

    interrupts:
      type: array
      category: required
      description: required interrupts
      generation: define
...
```

## dts/bindings/serial/riscv,reindeer-uart.yaml
```yaml
---
title: RISCV REINDEER UART
id: riscv,reindeer-uart
version: 0.1

description: >
    This binding gives a base representation of the RISCV REINDEER UART

inherits:
    !include uart.yaml

properties:
    compatible:
      type: string
      category: required
      description: compatible strings
      constraint: "riscv,reindeer-uart"

    reg:
      type: array
      description: mmio register space
      generation: define
      category: required

    interrupts:
      type: array
      category: required
      description: required interrupts
      generation: define
...
```

## soc/riscv32/riscv-privilege/pulserain-rattlesnake/Kconfig.defconfig.series
```kconfig
if SOC_SERIES_PULSERAIN_RATTLESNAKE

config SOC_SERIES
	string
	default "pulserain-rattlesnake"

config SYS_CLOCK_HW_CYCLES_PER_SEC
	int
	default 1000000

config RISCV_SOC_INTERRUPT_INIT
	bool
	default y

config RISCV_HAS_CPU_IDLE
	bool
	default n

config RISCV_HAS_PLIC
	bool
	default n

config INCLUDE_RESET_VECTOR
	bool
	default y

config NUM_IRQS
	int
	default 32

config XIP
	bool
	default n
    
config RISCV_ROM_BASE_ADDR
	hex
	default 0x80000000

config RISCV_ROM_SIZE
	hex
	default 0x40000

config RISCV_RAM_BASE_ADDR
	hex
	default	0x80040000

config RISCV_RAM_SIZE
	hex
	default 0x40000


endif # SOC_SERIES_PULSERAIN_RATTLESNAKE
```

## soc/riscv32/riscv-privilege/pulserain-rattlesnake/Kconfig.series
```kconfig
# Kconfig - PulseRain Rattlesnake SOC implementation
#
# Copyright (c) 2019 PulseRain Technology, LLC
#
# SPDX-License-Identifier: Apache-2.0
#

config SOC_SERIES_PULSERAIN_RATTLESNAKE
	bool "PulseRain Rattlesnake RISCV32 SOC implementation"
	depends on RISCV32
	select SOC_FAMILY_RISCV_PRIVILEGE
	help
	  Enable support for PulseRain Rattlesnake RISCV32 SOC implementation
```

## soc/riscv32/riscv-privilege/pulserain-rattlesnake/Kconfig.soc
```kconfig
# Kconfig - PULSERAIN_REINDEER SOC configuration options
#
# Copyright (c) 2018 PulseRain Technology, LLC
#
# SPDX-License-Identifier: Apache-2.0
#

choice
prompt "PulseRain Rattlesnake SOC implementation"
depends on SOC_SERIES_PULSERAIN_RATTLESNAKE

config SOC_PULSERAIN_RATTLESNAKE
	bool "PulseRain Rattlesnake SOC implementation"
	select ATOMIC_OPERATIONS_C

endchoice
```
